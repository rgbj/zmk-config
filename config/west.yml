## config/west.yml
```yaml
manifest:
  remotes:
    - name: rgbj
      url-base: https://github.com/rgbj
  projects:
    - name: zmk
      remote: rgbj
      revision: rollow
      import: app/west.yml
  self:
    path: config
```
